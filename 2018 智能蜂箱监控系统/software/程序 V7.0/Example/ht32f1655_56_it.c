//------------------My_interrupt.c---------------------//
#include "ht32.h"
#include "ht32_board.h"
#include "usart_int.h"
#include "UART.h"
#include "INIT.h"
#include "DELAY.h"



unsigned int WASHING_count;                             //定时器清洗，计数值LED3
unsigned int HEAT_count;                                //定时加热，计数值
unsigned int FEED_count;                                //定时喂食，计数值
extern unsigned char STEER_START_RUN_FLAG;              //舵机开始运转标志位,0表示停止运转，1表示开始运转
extern bool          HEAT_START_FLAG;                   //开始控制加热丝加热标志位
extern bool          FEED_START_FLAG;                   //开始喂食蜂箱标志位
extern bool          START_WASHING_FLAG;                //开始清洗蜂箱标志位
extern unsigned  int Washing_Time;                      //清洗时间，由上位机给定
extern unsigned  int Heat_Time;                         //加热时间，由上位机给定，单位秒
extern unsigned  int Feed_Time;                         //喂食时间，由上位机给定，单位秒
extern unsigned  int SECOND_Count;                              //定时秒时间计数
u16 time1ms,time5ms=0,time10ms=0;
u8 Stolen[]={0xAA,0x55,0x04,0x00,0x01,0x0B,0x0F};   //被盗指�//定时秒时间计数
u8 Wifi_Icon_ON[]={0x70,0x30,0x2E,0x70,0x69,0x63,0x3D,0x35,0x30,0xff,0xff,0xff};//图标 WIFI p0.pic=50 >>GREEN   已连接
u8 Wifi_Icon_OFF[]={0x70,0x30,0x2E,0x70,0x69,0x63,0x3D,0x34,0x39,0xff,0xff,0xff};//图标 WIFI p0.pic=49 >>RED    未连接
void Be_Stolen(void);
extern u8 recv1_data_ok;                //接收到正确的数据包
extern void DataBuffer_Deal(void);


//void BFTM1_IRQHandler(void)
//{
//	BFTM_ClearFlag(HT_BFTM1);
//	SECOND_Count++;
//}
void BFTM0_IRQHandler(void)   //定时器0中断
{

	BFTM_ClearFlag(HT_BFTM0);//清除标志位

  time5ms++;
	time10ms++;

	if(time5ms == 200)
	{		
		Be_Stolen();  //被盗提示
		time5ms=0;
		UART_Send_Temp();   //更新温度数值
		UART_SEND_Weight(); //更新重量数值
		if(recv1_data_ok == 1)
		{
			USART_Sends(HT_USART1,Wifi_Icon_ON,sizeof(Wifi_Icon_ON));				 //串口屏上显示 WIFI  已连接
		}
		else{USART_Sends(HT_USART1,Wifi_Icon_OFF,sizeof(Wifi_Icon_OFF));}  //串口屏上显示 WIFI  未连接
		
	}

	if(time10ms == 50) //500ms
	{
		LED1=!LED1;

		if(START_WASHING_FLAG==TRUE)
		  {
				WASHING_count++;
			  if(WASHING_count>=(Washing_Time*4))                  //清洗60S定时时间到 
			   {
				   WASHING_count=0;
					 Washing_Time=0;                                //清洗完成，清洗时间清0
				   GPIO_WriteOutBits(HT_GPIOC, GPIO_PIN_12, RESET); 			 //输出低，控制电磁阀1断开，停止进水	
					 START_WASHING_FLAG=FALSE;                      //开始清洗标志位清0 
		      }
	   	}
			if(HEAT_START_FLAG==TRUE)
			{
		    	HEAT_count++;
				  if(HEAT_count>=(Heat_Time*4))                      //加热丝加热时间到停止加热
					{
						Heat_Time=0;                                 //加热时间清0
					  HEAT_count=0;                                //加热时间计数值清0
						
						GPIO_WriteOutBits(HT_GPIOC, GPIO_PIN_9, RESET);            //PC9引脚置0，关闭加热
						GPIO_WriteOutBits(HT_GPIOC, GPIO_PIN_10, RESET);           //PC10引脚置0，关闭加热
						HEAT_START_FLAG=FALSE;                       //开始加热标志位清0
					}
			}
			if(FEED_START_FLAG==TRUE)
			{
		    	FEED_count++;
				  if(FEED_count>=(Feed_Time*4))                      //加热丝加热时间到停止加热
					{
						Feed_Time=0;                                 //加热时间清0
					  FEED_count=0;                                //加热时间计数值清0

						GPIO_WriteOutBits(HT_GPIOC, GPIO_PIN_11, RESET);              //PC11引脚置0，关闭喂食
						FEED_START_FLAG=FALSE;                       //开始加热标志位清0
					}
			}
	
			time10ms=0;
		}

}

void Be_Stolen()
{
	if(GATE == 0)
	{
			Stolen[4]=FX_NUMBER;
		
			USART_Sends(HT_USART0,Stolen,sizeof(Stolen));//向上位机发送被盗信息
	}
}





/* Global functions ----------------------------------------------------------------------------------------*/
/*********************************************************************************************************//**
 * @brief   This function handles NMI exception.
 * @retval  None
 ************************************************************************************************************/
void NMI_Handler(void)
{
}

/*********************************************************************************************************//**
 * @brief   This function handles Hard Fault exception.
 * @retval  None
 ************************************************************************************************************/
void HardFault_Handler(void)
{
  while (1);
}

/*********************************************************************************************************//**
 * @brief   This function handles Memory Manage exception.
 * @retval  None
 ************************************************************************************************************/
void MemManage_Handler(void)
{
  while (1);
}

/*********************************************************************************************************//**
 * @brief   This function handles Bus Fault exception.
 * @retval  None
 ************************************************************************************************************/
void BusFault_Handler(void)
{
  while (1);
}

/*********************************************************************************************************//**
 * @brief   This function handles Usage Fault exception.
 * @retval  None
 ************************************************************************************************************/
void UsageFault_Handler(void)
{
  while (1);
}

/*********************************************************************************************************//**
 * @brief   This function handles SVCall exception.
 * @retval  None
 ************************************************************************************************************/
void SVC_Handler(void)
{
}

/*********************************************************************************************************//**
 * @brief   This function handles Debug Monitor exception.
 * @retval  None
 ************************************************************************************************************/
void DebugMon_Handler(void)
{
}

/*********************************************************************************************************//**
 * @brief   This function handles PendSVC exception.
 * @retval  None
 ************************************************************************************************************/
void PendSV_Handler(void)
{
}

/*********************************************************************************************************//**
 * @brief   This function handles SysTick Handler.
 * @retval  None
 ************************************************************************************************************/
//void SysTick_Handler(void)
//{
//}

/*********************************************************************************************************//**
 * @brief   This function handles Clock Ready interrupt.
 * @retval  None
 ************************************************************************************************************/
//void CKRDY_IRQHandler(void)
//{
//}

/*********************************************************************************************************//**
 * @brief   This function handles Low Voltage Detection interrupt.
 * @retval  None
 ************************************************************************************************************/
//void LVD_IRQHandler(void)
//{
//}

/*********************************************************************************************************//**
 * @brief   This function handles Brown Out Detection interrupt.
 * @retval  None
 ************************************************************************************************************/
//void BOD_IRQHandler(void)
//{
//}

/*********************************************************************************************************//**
 * @brief   This function handles WDT interrupt.
 * @retval  None
 ************************************************************************************************************/
//void WDT_IRQHandler(void)
//{
//}

/*********************************************************************************************************//**
 * @brief   This function handles RTC interrupt.
 * @retval  None
 ************************************************************************************************************/
//void RTC_IRQHandler(void)
//{
//}

/*********************************************************************************************************//**
 * @brief   This function handles Flash interrupt.
 * @retval  None
 ************************************************************************************************************/
//void FLASH_IRQHandler(void)
//{
//}

/*********************************************************************************************************//**
 * @brief   This function handles Event Wake Up interrupt.
 * @retval  None
 ************************************************************************************************************/
//void EVWUP_IRQHandler(void)
//{
//}

/*********************************************************************************************************//**
 * @brief   This function handles WAKEUP pin interrupt.
 * @retval  None
 ************************************************************************************************************/
//void LPWUP_IRQHandler(void)
//{
//}

/*********************************************************************************************************//**
 * @brief   This function handles EXTI0 interrupt.
 * @retval  None
 ************************************************************************************************************/
//void EXTI0_IRQHandler(void)
//{
//}

/*********************************************************************************************************//**
 * @brief   This function handles EXTI1 interrupt.
 * @retval  None
 ************************************************************************************************************/
//void EXTI1_IRQHandler(void)
//{
//}

/*********************************************************************************************************//**
 * @brief   This function handles EXTI2 interrupt.
 * @retval  None
 ************************************************************************************************************/
//void EXTI2_IRQHandler(void)
//{
//}

/*********************************************************************************************************//**
 * @brief   This function handles EXTI3 interrupt.
 * @retval  None
 ************************************************************************************************************/
//void EXTI3_IRQHandler(void)
//{
//}

/*********************************************************************************************************//**
 * @brief   This function handles EXTI4 interrupt.
 * @retval  None
 ************************************************************************************************************/
//void EXTI4_IRQHandler(void)
//{
//}

/*********************************************************************************************************//**
 * @brief   This function handles EXTI5 interrupt.
 * @retval  None
 ************************************************************************************************************/
//void EXTI5_IRQHandler(void)
//{
//}

/*********************************************************************************************************//**
 * @brief   This function handles EXTI6 interrupt.
 * @retval  None
 ************************************************************************************************************/
//void EXTI6_IRQHandler(void)
//{
//}

/*********************************************************************************************************//**
 * @brief   This function handles EXTI7 interrupt.
 * @retval  None
 ************************************************************************************************************/
//void EXTI7_IRQHandler(void)
//{
//}

/*********************************************************************************************************//**
 * @brief   This function handles EXTI8 interrupt.
 * @retval  None
 ************************************************************************************************************/
//void EXTI8_IRQHandler(void)
//{
//}

/*********************************************************************************************************//**
 * @brief   This function handles EXTI9 interrupt.
 * @retval  None
 ************************************************************************************************************/
//void EXTI9_IRQHandler(void)
//{
//}

/*********************************************************************************************************//**
 * @brief   This function handles EXTI10 interrupt.
 * @retval  None
 ************************************************************************************************************/
//void EXTI10_IRQHandler(void)
//{
//}

/*********************************************************************************************************//**
 * @brief   This function handles EXTI11 interrupt.
 * @retval  None
 ************************************************************************************************************/
//void EXTI11_IRQHandler(void)
//{
//}

/*********************************************************************************************************//**
 * @brief   This function handles EXTI12 interrupt.
 * @retval  None
 ************************************************************************************************************/
//void EXTI12_IRQHandler(void)
//{
//}

/*********************************************************************************************************//**
 * @brief   This function handles EXTI13 interrupt.
 * @retval  None
 ************************************************************************************************************/
//void EXTI13_IRQHandler(void)
//{
//}

/*********************************************************************************************************//**
 * @brief   This function handles EXTI14 interrupt.
 * @retval  None
 ************************************************************************************************************/
//void EXTI14_IRQHandler(void)
//{
//}

/*********************************************************************************************************//**
 * @brief   This function handles EXTI15 interrupt.
 * @retval  None
 ************************************************************************************************************/
//void EXTI15_IRQHandler(void)
//{
//}

/*********************************************************************************************************//**
 * @brief   This function handles Comparator interrupt.
 * @retval  None
 ************************************************************************************************************/
//void COMP_IRQHandler(void)
//{
//}

/*********************************************************************************************************//**
 * @brief   This function handles ADC interrupt.
 * @retval  None
 ************************************************************************************************************/
//void ADC_IRQHandler(void)
//{
//}

/*********************************************************************************************************//**
 * @brief   This function handles MCTM0 BRK interrupt.
 * @retval  None
 ************************************************************************************************************/
//void MCTM0BRK_IRQHandler(void)
//{
//}

/*********************************************************************************************************//**
 * @brief   This function handles MCTM0 UP interrupt.
 * @retval  None
 ************************************************************************************************************/
//void MCTM0UP_IRQHandler(void)
//{
//}

/*********************************************************************************************************//**
 * @brief   This function handles MCTM0 TR interrupt.
 * @retval  None
 ************************************************************************************************************/
//void MCTM0TR_IRQHandler(void)
//{
//}

/*********************************************************************************************************//**
 * @brief   This function handles MCTM0 CC interrupt.
 * @retval  None
 ************************************************************************************************************/
//void MCTM0CC_IRQHandler(void)
//{
//}

/*********************************************************************************************************//**
 * @brief   This function handles MCTM1 BRK interrupt.
 * @retval  None
 ************************************************************************************************************/
//void MCTM1BRK_IRQHandler(void)
//{
//}

/*********************************************************************************************************//**
 * @brief   This function handles MCTM1 UP interrupt.
 * @retval  None
 ************************************************************************************************************/
//void MCTM1UP_IRQHandler(void)
//{
//}

/*********************************************************************************************************//**
 * @brief   This function handles MCTM1 TR interrupt.
 * @retval  None
 ************************************************************************************************************/
//void MCTM1TR_IRQHandler(void)
//{
//}

/*********************************************************************************************************//**
 * @brief   This function handles MCTM1 CC interrupt.
 * @retval  None
 ************************************************************************************************************/
//void MCTM1CC_IRQHandler(void)
//{
//}

/*********************************************************************************************************//**
 * @brief   This function handles General Purpose Timer 0 interrupt.
 * @retval  None
 ************************************************************************************************************/
//void GPTM0_IRQHandler(void)
//{
//}

/*********************************************************************************************************//**
 * @brief   This function handles General Purpose Timer 1 interrupt.
 * @retval  None
 ************************************************************************************************************/
//void GPTM1_IRQHandler(void)
//{
//}

/*********************************************************************************************************//**
 * @brief   This function handles Basic Function Timer 0 interrupt.
 * @retval  None
 ************************************************************************************************************/
//void BFTM0_IRQHandler(void)
//{
//}

/*********************************************************************************************************//**
 * @brief   This function handles Basic Function Timer 1 interrupt.
 * @retval  None
 ************************************************************************************************************/
//void BFTM1_IRQHandler(void)
//{
//}

/*********************************************************************************************************//**
 * @brief   This function handles I2C0 interrupt.
 * @retval  None
 ************************************************************************************************************/
//void I2C0_IRQHandler(void)
//{
//}

/*********************************************************************************************************//**
 * @brief   This function handles I2C1 interrupt.
 * @retval  None
 ************************************************************************************************************/
//void I2C1_IRQHandler(void)
//{
//}

/*********************************************************************************************************//**
 * @brief   This function handles SPI0 interrupt.
 * @retval  None
 ************************************************************************************************************/
//void SPI0_IRQHandler(void)
//{
//}

/*********************************************************************************************************//**
 * @brief   This function handles SPI1 interrupt.
 * @retval  None
 ************************************************************************************************************/
//void SPI1_IRQHandler(void)
//{
//}

/*********************************************************************************************************//**
 * @brief   This function handles USART0 interrupt.
 * @retval  None
 ************************************************************************************************************/
//void USART0_IRQHandler(void)
//{
//}

/*********************************************************************************************************//**
 * @brief   This function handles USART1 interrupt.
 * @retval  None
 ************************************************************************************************************/
//void USART1_IRQHandler(void)
//{
//}

/*********************************************************************************************************//**
 * @brief   This function handles UART0 interrupt.
 * @retval  None
 ************************************************************************************************************/
//void UART0_IRQHandler(void)
//{
//}

/*********************************************************************************************************//**
 * @brief   This function handles UART1 interrupt.
 * @retval  None
 ************************************************************************************************************/
//void UART1_IRQHandler(void)
//{
//}

/*********************************************************************************************************//**
 * @brief   This function handles Smart Card interrupt.
 * @retval  None
 ************************************************************************************************************/
//void SCI_IRQHandler(void)
//{
//}

/*********************************************************************************************************//**
 * @brief   This function handles I2S interrupt.
 * @retval  None
 ************************************************************************************************************/
//void I2S_IRQHandler(void)
//{
//}

/*********************************************************************************************************//**
 * @brief   This function handles USB interrupt.
 * @retval  None
 ************************************************************************************************************/
//void USB_IRQHandler(void)
//{
//}

/*********************************************************************************************************//**
 * @brief   This function handles PDMA_CH0 interrupt.
 * @retval  None
 ************************************************************************************************************/
//void PDMA_CH0_IRQHandler(void)
//{
//}

/*********************************************************************************************************//**
 * @brief   This function handles PDMA_CH1 interrupt.
 * @retval  None
 ************************************************************************************************************/
//void PDMA_CH1_IRQHandler(void)
//{
//}

/*********************************************************************************************************//**
 * @brief   This function handles PDMA_CH2 interrupt.
 * @retval  None
 ************************************************************************************************************/
//void PDMA_CH2_IRQHandler(void)
//{
//}

/*********************************************************************************************************//**
 * @brief   This function handles PDMA_CH3 interrupt.
 * @retval  None
 ************************************************************************************************************/
//void PDMA_CH3_IRQHandler(void)
//{
//}

/*********************************************************************************************************//**
 * @brief   This function handles PDMA_CH4 interrupt.
 * @retval  None
 ************************************************************************************************************/
//void PDMA_CH4_IRQHandler(void)
//{
//}

/*********************************************************************************************************//**
 * @brief   This function handles PDMA_CH5 interrupt.
 * @retval  None
 ************************************************************************************************************/
//void PDMA_CH5_IRQHandler(void)
//{
//}

/*********************************************************************************************************//**
 * @brief   This function handles PDMA_CH6 interrupt.
 * @retval  None
 ************************************************************************************************************/
//void PDMA_CH6_IRQHandler(void)
//{
//}

/*********************************************************************************************************//**
 * @brief   This function handles PDMA_CH7 interrupt.
 * @retval  None
 ************************************************************************************************************/
//void PDMA_CH7_IRQHandler(void)
//{
//}

/*********************************************************************************************************//**
 * @brief   This function handles External Bus Interface interrupt.
 * @retval  None
 ************************************************************************************************************/
//void EBI_IRQHandler(void)
//{
//}


/**
  * @}
  */

/**
  * @}
  */

/**
  * @}
  */
	
	
